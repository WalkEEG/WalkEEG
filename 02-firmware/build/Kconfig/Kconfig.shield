## 02-firmware/build/Kconfig/arch/Kconfig
```kconfig
# Load Zephyr Arch Kconfig descriptions.
osource "D:/ncs/v3.2.1/zephyr/arch/rx/Kconfig"
osource "D:/ncs/v3.2.1/zephyr/arch/x86/Kconfig"
osource "D:/ncs/v3.2.1/zephyr/arch/xtensa/Kconfig"
osource "D:/ncs/v3.2.1/zephyr/arch/sparc/Kconfig"
osource "D:/ncs/v3.2.1/zephyr/arch/riscv/Kconfig"
osource "D:/ncs/v3.2.1/zephyr/arch/posix/Kconfig"
osource "D:/ncs/v3.2.1/zephyr/arch/mips/Kconfig"
osource "D:/ncs/v3.2.1/zephyr/arch/arm64/Kconfig"
osource "D:/ncs/v3.2.1/zephyr/arch/arm/Kconfig"
osource "D:/ncs/v3.2.1/zephyr/arch/arc/Kconfig"
```

## 02-firmware/build/Kconfig/boards/Kconfig
```kconfig
# Load Zephyr board Kconfig descriptions.
osource "D:/ncs/v3.2.1/zephyr/boards/nordic/nrf52840dk/Kconfig"
```

## 03-central-uart/build/Kconfig/boards/Kconfig.defconfig
```kconfig
# Load Zephyr board defconfig descriptions.
osource "D:/ncs/v3.2.1/zephyr/boards/nordic/nrf52dk/Kconfig.defconfig"
```

## 04-peripheral-debug/build/Kconfig/boards/Kconfig.sysbuild
```kconfig
# Load Sysbuild board Kconfig descriptions.
osource "D:/ncs/v3.2.1/zephyr/boards/nordic/nrf52dk/Kconfig.sysbuild"
```

## 04-peripheral-debug/build/Kconfig/soc/Kconfig
```kconfig
# Load Zephyr SoC Kconfig descriptions.
osource "D:/ncs/v3.2.1/zephyr/soc/xlnx/zynqmp/Kconfig"
osource "D:/ncs/v3.2.1/zephyr/soc/xlnx/zynq7000/Kconfig"
osource "D:/ncs/v3.2.1/zephyr/soc/xlnx/versalnet/Kconfig"
osource "D:/ncs/v3.2.1/zephyr/soc/xlnx/versal2/Kconfig"
osource "D:/ncs/v3.2.1/zephyr/soc/xen/Kconfig"
osource "D:/ncs/v3.2.1/zephyr/soc/wch/ch32v/Kconfig"
osource "D:/ncs/v3.2.1/zephyr/soc/ti/simplelink/Kconfig"
osource "D:/ncs/v3.2.1/zephyr/soc/ti/mspm0/Kconfig"
osource "D:/ncs/v3.2.1/zephyr/soc/ti/lm3s6965/Kconfig"
osource "D:/ncs/v3.2.1/zephyr/soc/ti/k3/Kconfig"
osource "D:/ncs/v3.2.1/zephyr/soc/telink/tlsr/Kconfig"
osource "D:/ncs/v3.2.1/zephyr/soc/starfive/jh71xx/Kconfig"
osource "D:/ncs/v3.2.1/zephyr/soc/st/stm32/Kconfig"
osource "D:/ncs/v3.2.1/zephyr/soc/snps/qemu_arc/Kconfig"
osource "D:/ncs/v3.2.1/zephyr/soc/snps/nsim/arc_v/Kconfig"
osource "D:/ncs/v3.2.1/zephyr/soc/snps/nsim/arc_classic/Kconfig"
osource "D:/ncs/v3.2.1/zephyr/soc/snps/hsdk4xd/Kconfig"
osource "D:/ncs/v3.2.1/zephyr/soc/snps/hsdk/Kconfig"
osource "D:/ncs/v3.2.1/zephyr/soc/snps/emsk/Kconfig"
osource "D:/ncs/v3.2.1/zephyr/soc/snps/emsdp/Kconfig"
osource "D:/ncs/v3.2.1/zephyr/soc/snps/arc_iot/Kconfig"
osource "D:/ncs/v3.2.1/zephyr/soc/silabs/Kconfig"
osource "D:/ncs/v3.2.1/zephyr/soc/sifive/sifive_freedom/Kconfig"
osource "D:/ncs/v3.2.1/zephyr/soc/sensry/Kconfig"
osource "D:/ncs/v3.2.1/zephyr/soc/rockchip/Kconfig"
osource "D:/ncs/v3.2.1/zephyr/soc/renode/riscv_virtual/Kconfig"
osource "D:/ncs/v3.2.1/zephyr/soc/renode/cortex_r8_virtual/Kconfig"
osource "D:/ncs/v3.2.1/zephyr/soc/renesas/smartbond/Kconfig"
osource "D:/ncs/v3.2.1/zephyr/soc/renesas/rz/Kconfig"
osource "D:/ncs/v3.2.1/zephyr/soc/renesas/rx/Kconfig"
osource "D:/ncs/v3.2.1/zephyr/soc/renesas/rcar/Kconfig"
osource "D:/ncs/v3.2.1/zephyr/soc/renesas/ra/Kconfig"
osource "D:/ncs/v3.2.1/zephyr/soc/realtek/ec/Kconfig"
osource "D:/ncs/v3.2.1/zephyr/soc/raspberrypi/rpi_pico/Kconfig"
osource "D:/ncs/v3.2.1/zephyr/soc/quicklogic/eos_s3/Kconfig"
osource "D:/ncs/v3.2.1/zephyr/soc/qemu/virt_riscv/Kconfig"
osource "D:/ncs/v3.2.1/zephyr/soc/qemu/malta/Kconfig"
osource "D:/ncs/v3.2.1/zephyr/soc/openisa/rv32m1/Kconfig"
osource "D:/ncs/v3.2.1/zephyr/soc/openhwgroup/cva6/Kconfig"
osource "D:/ncs/v3.2.1/zephyr/soc/oct/osd32mp15x/Kconfig"
osource "D:/ncs/v3.2.1/zephyr/soc/nxp/s32/Kconfig"
osource "D:/ncs/v3.2.1/zephyr/soc/nxp/rw/Kconfig"
osource "D:/ncs/v3.2.1/zephyr/soc/nxp/mcx/Kconfig"
osource "D:/ncs/v3.2.1/zephyr/soc/nxp/lpc/Kconfig"
osource "D:/ncs/v3.2.1/zephyr/soc/nxp/layerscape/Kconfig"
osource "D:/ncs/v3.2.1/zephyr/soc/nxp/kinetis/Kconfig"
osource "D:/ncs/v3.2.1/zephyr/soc/nxp/imxrt/Kconfig"
osource "D:/ncs/v3.2.1/zephyr/soc/nxp/imx/Kconfig"
osource "D:/ncs/v3.2.1/zephyr/soc/nuvoton/numicro/Kconfig"
osource "D:/ncs/v3.2.1/zephyr/soc/nuvoton/numaker/Kconfig"
osource "D:/ncs/v3.2.1/zephyr/soc/nuvoton/npcx/Kconfig"
osource "D:/ncs/v3.2.1/zephyr/soc/nuvoton/npcm/Kconfig"
osource "D:/ncs/v3.2.1/zephyr/soc/nordic/Kconfig"
osource "D:/ncs/v3.2.1/zephyr/soc/neorv32/Kconfig"
osource "D:/ncs/v3.2.1/zephyr/soc/native/inf_clock/Kconfig"
osource "D:/ncs/v3.2.1/zephyr/soc/microchip/sam/Kconfig"
osource "D:/ncs/v3.2.1/zephyr/soc/microchip/sam/sam_d5x_e5x/Kconfig"
osource "D:/ncs/v3.2.1/zephyr/soc/microchip/miv/Kconfig"
osource "D:/ncs/v3.2.1/zephyr/soc/microchip/mec/Kconfig"
osource "D:/ncs/v3.2.1/zephyr/soc/mediatek/mt8xxx/Kconfig"
osource "D:/ncs/v3.2.1/zephyr/soc/lowrisc/opentitan/Kconfig"
osource "D:/ncs/v3.2.1/zephyr/soc/litex/litex_vexriscv/Kconfig"
osource "D:/ncs/v3.2.1/zephyr/soc/ite/ec/Kconfig"
osource "D:/ncs/v3.2.1/zephyr/soc/intel/raptor_lake/Kconfig"
osource "D:/ncs/v3.2.1/zephyr/soc/intel/panther_lake/Kconfig"
osource "D:/ncs/v3.2.1/zephyr/soc/intel/lakemont/Kconfig"
osource "D:/ncs/v3.2.1/zephyr/soc/intel/intel_socfpga_std/Kconfig"
osource "D:/ncs/v3.2.1/zephyr/soc/intel/intel_socfpga/Kconfig"
osource "D:/ncs/v3.2.1/zephyr/soc/intel/intel_niosv/Kconfig"
osource "D:/ncs/v3.2.1/zephyr/soc/intel/intel_ish/Kconfig"
osource "D:/ncs/v3.2.1/zephyr/soc/intel/intel_adsp/Kconfig"
osource "D:/ncs/v3.2.1/zephyr/soc/intel/elkhart_lake/Kconfig"
osource "D:/ncs/v3.2.1/zephyr/soc/intel/atom/Kconfig"
osource "D:/ncs/v3.2.1/zephyr/soc/intel/apollo_lake/Kconfig"
osource "D:/ncs/v3.2.1/zephyr/soc/intel/alder_lake/Kconfig"
osource "D:/ncs/v3.2.1/zephyr/soc/infineon/cat3/Kconfig"
osource "D:/ncs/v3.2.1/zephyr/soc/infineon/cat1c/Kconfig"
osource "D:/ncs/v3.2.1/zephyr/soc/infineon/cat1b/Kconfig"
osource "D:/ncs/v3.2.1/zephyr/soc/infineon/cat1a/Kconfig"
osource "D:/ncs/v3.2.1/zephyr/soc/gd/gd32/Kconfig"
osource "D:/ncs/v3.2.1/zephyr/soc/gaisler/leon3/Kconfig"
osource "D:/ncs/v3.2.1/zephyr/soc/gaisler/gr716a/Kconfig"
osource "D:/ncs/v3.2.1/zephyr/soc/espressif/Kconfig"
osource "D:/ncs/v3.2.1/zephyr/soc/ene/kb1200/Kconfig"
osource "D:/ncs/v3.2.1/zephyr/soc/ene/kb106x/Kconfig"
osource "D:/ncs/v3.2.1/zephyr/soc/efinix/sapphire/Kconfig"
osource "D:/ncs/v3.2.1/zephyr/soc/cdns/xtensa_sample_controller/Kconfig"
osource "D:/ncs/v3.2.1/zephyr/soc/cdns/sample_controller32/Kconfig"
osource "D:/ncs/v3.2.1/zephyr/soc/cdns/dc233c/Kconfig"
osource "D:/ncs/v3.2.1/zephyr/soc/brcm/bcmvk/Kconfig"
osource "D:/ncs/v3.2.1/zephyr/soc/brcm/bcm2712/Kconfig"
osource "D:/ncs/v3.2.1/zephyr/soc/brcm/bcm2711/Kconfig"
osource "D:/ncs/v3.2.1/zephyr/soc/bflb/Kconfig"
osource "D:/ncs/v3.2.1/zephyr/soc/atmel/sam0/Kconfig"
osource "D:/ncs/v3.2.1/zephyr/soc/atmel/sam/Kconfig"
osource "D:/ncs/v3.2.1/zephyr/soc/aspeed/Kconfig"
osource "D:/ncs/v3.2.1/zephyr/soc/arm/Kconfig"
osource "D:/ncs/v3.2.1/zephyr/soc/arm/beetle/Kconfig"
osource "D:/ncs/v3.2.1/zephyr/soc/antmicro/myra/Kconfig"
osource "D:/ncs/v3.2.1/zephyr/soc/andestech/Kconfig"
osource "D:/ncs/v3.2.1/zephyr/soc/amd/acp_6_0/Kconfig"
osource "D:/ncs/v3.2.1/zephyr/soc/ambiq/Kconfig"
osource "D:/ncs/v3.2.1/zephyr/soc/aesc/Kconfig"
osource "D:/ncs/v3.2.1/zephyr/soc/adi/max32/Kconfig"
osource "D:/ncs/v3.2.1/nrf/soc/sercomm/nrf91/Kconfig"
osource "D:/ncs/v3.2.1/nrf/soc/nordic/Kconfig"
```
